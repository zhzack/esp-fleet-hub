## IDF/ble_hid/sdkconfig.defaults
```kconfig
# ---- target ----
CONFIG_IDF_TARGET="esp32s3"

# ---- partition table ----
CONFIG_PARTITION_TABLE_CUSTOM=y
CONFIG_PARTITION_TABLE_CUSTOM_FILENAME="partitions.csv"

# ---- main task ----
CONFIG_ESP_MAIN_TASK_STACK_SIZE=6144

# ---- FreeRTOS ----
CONFIG_FREERTOS_HZ=1000

# ---- SPI RAM (N16R8) ----
CONFIG_SPIRAM=y
CONFIG_SPIRAM_MODE_OCT=y
CONFIG_SPIRAM_SPEED_80M=y
CONFIG_SPIRAM_USE_MALLOC=y
CONFIG_SPIRAM_TRY_ALLOCATE_WIFI_LWIP=y

# ---- WiFi ----
CONFIG_ESP_WIFI_STATIC_RX_BUFFER_NUM=10
CONFIG_ESP_WIFI_DYNAMIC_TX_BUFFER_NUM=32

# ---- LWIP ----
CONFIG_LWIP_MAX_SOCKETS=10

# ---- WebSocket (managed component will be added) ----
CONFIG_WS_TRANSPORT=y

# ---- NimBLE (BLE HID) ----
CONFIG_BT_ENABLED=y
CONFIG_BT_NIMBLE_ENABLED=y
CONFIG_BT_NIMBLE_ROLE_PERIPHERAL=y
CONFIG_BT_NIMBLE_ROLE_BROADCASTER=y
CONFIG_BT_NIMBLE_ROLE_CENTRAL=n
CONFIG_BT_NIMBLE_ROLE_OBSERVER=n
CONFIG_BT_NIMBLE_MAX_CONNECTIONS=1

# ---- cJSON (built-in) ----
CONFIG_JSON_USE_CJSON=y

# ---- Task WDT ----
CONFIG_ESP_TASK_WDT_INIT=y
CONFIG_ESP_TASK_WDT_TIMEOUT_S=10

# ---- Logs ----
CONFIG_LOG_DEFAULT_LEVEL_INFO=y
CONFIG_LOG_COLORS=y
```

## ble_hid/main/Kconfig.projbuild
```kconfig
menu "ble_hid app config"

    config APP_DEFAULT_WIFI_SSID
        string "Default WiFi SSID"
        default "1"
        help
            连接的 WiFi SSID。NVS 里没存值时使用此默认。

    config APP_DEFAULT_WIFI_PASS
        string "Default WiFi password"
        default "11111111"
        help
            WiFi 密码。

    config APP_DEFAULT_SERVER_HOST
        string "Default WS server host"
        default "192.168.68.159"
        help
            WebSocket 服务器 IP（PC 上跑 ws_tester.py 或 FastAPI 的那台）。

    config APP_DEFAULT_SERVER_PORT
        int "Default WS server port"
        default 8000
        range 1 65535

    config APP_DEFAULT_DEVICE_ID
        string "Default device id"
        default "esp32_001"
        help
            注册时上报给后端的 device_id。

    config APP_OTA_TEST_UNHEALTHY
        bool "Force OTA health-check to fail (E2E rollback test)"
        default n
        help
            打开后新固件的健康自检永远不通过，OTA 升级后 90s 必定回滚旧分区。
            仅用于真机验证自动回滚链路，量产构建严禁开启。

endmenu
```

## esp_unified_framework/main/Kconfig.projbuild
```kconfig
menu "ESP Unified Framework - LuatOS-Style Component Matrix"

    menu "Network & Interface Services"
        config FEATURE_HTTP_SERVER
            bool "Enable HTTP Server Engine"
            default y
            help
                Starts background HTTP server task on configured port (e.g. 80).
                If disabled, completely strips HTTP networking stack, saving RAM and Flash.

        config FEATURE_WEB_UI
            bool "Enable Web Management Dashboard Portal"
            depends on FEATURE_HTTP_SERVER
            default y
            help
                Embeds HTML5/CSS/JS responsive dashboard in Flash.
                Disable this to produce ultra-lightweight Headless API firmwares.

        config FEATURE_REST_API
            bool "Enable HTTP REST Configuration API"
            depends on FEATURE_HTTP_SERVER
            default y
            help
                Exposes /api/system/*, /api/gpio/*, /api/config for programmatic control.

        config FEATURE_OTA
            bool "Enable Wireless Dual-Partition OTA Updates"
            default y
            help
                Provides /api/ota/upload endpoint and dual-partition A/B rollback safety.

        config FEATURE_SERIAL_CLI
            bool "Enable Interactive UART / USB-Serial CLI Provisioning"
            default y
            help
                Enables lightweight non-blocking serial command console for local setup and recovery.

        config FEATURE_FLEET_AGENT
            bool "Enable Fleet Hub Auto-Registration & Config Shadow Sync"
            default y
            help
                Discovers Fleet Hub over mDNS (_esp-hub._tcp) or hub_url, authenticates with HMAC-SHA256,
                registers capabilities, sends periodic heartbeats, and syncs remote config/OTA commands.
    endmenu

    menu "Hardware Peripheral Drivers"
        config FEATURE_GPIO_CTRL
            bool "Enable GPIO Control Matrix (Digital In/Out & PWM)"
            default y
            help
                Exposes dynamic GPIO pin toggling, state reading, and PWM sliders.

        config FEATURE_CAMERA
            bool "Enable Camera Module (OV2640 / OV5640 with PSRAM)"
            default y
            help
                Enables Camera HAL, dual PSRAM framebuffers, MJPEG streaming (/stream), and snapshot capture.

        config FEATURE_STORAGE
            bool "Enable Storage Explorer (SPIFFS / SD Card)"
            default n
            help
                Mounts on-board flash storage or SD card.

        config FEATURE_DISPLAY
            bool "Enable Display Engine (ST7789 / E-Paper SSD1680)"
            default n
            help
                Enables LCD / E-Paper graphics driver.

        config FEATURE_USB_OTG
            bool "Enable Native USB OTG (HID Keyboard/Mouse/UVC) [ESP32-S2/S3 Only]"
            default n
            help
                Enables TinyUSB hardware driver for virtual input injection.

        config FEATURE_PC_MONITOR
            bool "Enable PC Monitor Hub (Air101 ST7735 80x160 Portrait LCD & Push API) [ESP32-C3]"
            default n
            help
                Enables ST7735 0.96-inch 80x160 portrait LCD driver, live PC telemetry rendering,
                and REST API /api/monitor/push.

        config FEATURE_JOYSTICK
            bool "Enable 5-Way Joystick Navigation Keypad (GPIO 4/5/8/9/13) [ESP32-C3]"
            default n
            help
                Enables 5-way joystick driver for media/volume and UI control.

        config FEATURE_WS_GATEWAY
            bool "Enable WebSocket V2 HID Gateway Client (connects to py_web /ws/device)"
            default n
            help
                Maintains persistent WebSocket connection to py_web HID Gateway Server
                so console/trackpad/macros dispatch low-latency HID actions to this node.
    endmenu

    menu "Hardware Board Pinout Profile"
        choice BOARD_PROFILE
            prompt "Target Board Profile"
            default BOARD_AUTO_DEFAULT
            help
                Selects board-specific default GPIO pinouts, camera SCCB/DVP wiring, and LED polarities.

            config BOARD_AUTO_DEFAULT
                bool "Auto Select Default Board by Target SoC"
            config BOARD_ESP32_CAM_AITHINKER
                bool "AI-Thinker ESP32-CAM"
            config BOARD_ESP32S3_CAM_DEV
                bool "ESP32-S3 CAM (Freenove / Goouuu S3)"
            config BOARD_ESP32S3_DEVKIT
                bool "ESP32-S3 DevKitC Generic"
            config BOARD_ESP32C3_AIR101
                bool "LuatOS ESP32-C3 + Air101 LCD Shield"
            config BOARD_ESP32C3_SUPERMINI
                bool "ESP32-C3 SuperMini / Core"
            config BOARD_ESP32_GENERIC
                bool "ESP32 Classic DevKit Generic"
            config BOARD_ESP32C2_GENERIC
                bool "ESP32-C2 Minimal Generic"
        endchoice
    endmenu

    menu "Default Network & Device Identity"
        config APP_FW_VERSION
            string "Firmware Version Tag"
            default "1.1.0-unified"

        config APP_DEFAULT_WIFI_SSID
            string "Default WiFi SSID"
            default "1"

        config APP_DEFAULT_WIFI_PASS
            string "Default WiFi Password"
            default "11111111"

        config APP_DEFAULT_DEVICE_ID
            string "Default Device ID (empty = auto MAC-based)"
            default ""

        config APP_MDNS_HOST
            string "Default mDNS Hostname"
            default "esp-node"

        config APP_DEFAULT_HUB_URL
            string "Default Fleet Hub URL (empty = auto mDNS discovery)"
            default ""

        config APP_DEFAULT_WS_GATEWAY_URL
            string "Default py_web WebSocket URL (empty = derive from Hub :8000)"
            default ""
    endmenu

endmenu
```
